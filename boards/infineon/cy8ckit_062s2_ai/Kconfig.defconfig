## boards/infineon/cy8ckit_062s2_ai/Kconfig.defconfig
```kconfig
# CY8CKIT-062S2-AI PSOC 6 AI Evaluation Kit configuration
#
# Copyright (c) 2024 Arrow Electronics.
# SPDX-License-Identifier: Apache-2.0

if BOARD_CY8CKIT_062S2_AI

if WIFI || BT

# Select AIROC part and module
choice AIROC_PART
	default CYW43439
endchoice

choice CYW43439_MODULE
	default CYW43439_MURATA_1YN
endchoice

endif # WIFI || BT

if WIFI

# Enable L2 Ethernet
config NET_L2_ETHERNET
	default y

endif # WIFI

if BT

# UART is required for BT HCI H4 transport
config UART
	bool
	default y

# Required to drive WL_REG_ON (P2.6) HIGH via regulator-fixed at boot
config REGULATOR
	bool
	default y

endif # BT

# Heap pool size for BT/WIFI stacks
config HEAP_MEM_POOL_ADD_SIZE_BOARD
	int
	default 15000 if WIFI
	default 4096

endif # BOARD_CY8CKIT_062S2_AI
```

## boards/infineon/kit_pse84_ai/kit_pse84_ai_m33_defconfig
```kconfig
# SPDX-FileCopyrightText: <text>Copyright (c) 2026 Infineon Technologies AG,
# or an affiliate of Infineon Technologies AG. All rights reserved.</text>
#
# SPDX-License-Identifier: Apache-2.0

# Enable FPU
CONFIG_FPU=y

# General configuration
CONFIG_CORTEX_M_SYSTICK=y
CONFIG_BUILD_OUTPUT_HEX=y

CONFIG_ARM_MPU=y
CONFIG_HW_STACK_PROTECTION=y

# Enable GPIO driver
CONFIG_GPIO=y

# Enable Clock Control driver
CONFIG_CLOCK_CONTROL=y

# Enable console
CONFIG_CONSOLE=y
CONFIG_UART_CONSOLE=y

# Enable UART driver
CONFIG_SERIAL=y

# Enable assert
CONFIG_ASSERT=y

CONFIG_ARM_TRUSTZONE_M=y
CONFIG_ARM_MPU=y

# Build a Secure firmware image
CONFIG_TRUSTED_EXECUTION_SECURE=y

CONFIG_CODE_DATA_RELOCATION=y

CONFIG_USE_DT_CODE_PARTITION=y

# Heap required by Infineon btstack-integration RTOS abstraction layer.
# cy_rtos_create_thread() allocates the BTU task stack (BTU_TASK_STACK_SIZE=0x2400)
# and the task memory pool (CYBT_TASK_DEFAULT_POOL_SIZE=2048) from the heap.
# Without this, k_aligned_alloc() returns NULL and the BT thread is created
# with a NULL stack pointer, causing an immediate stack overflow fault.
CONFIG_HEAP_MEM_POOL_SIZE=16384

# BT RX thread stack - default 1200 is sufficient for basic peripheral/beacon,
# increase if callbacks perform complex operations.
CONFIG_BT_RX_STACK_SIZE=4096

# Use ZMS instead of NVS as the settings backend.
# The s25hs512t external flash has a 256KB erase-block-size, which exceeds
# NVS's uint16_t sector_size limit (max 64KB), causing settings_subsys_init
# to fail with -EDOM. ZMS uses uint32_t sector_size and handles 256KB blocks.
CONFIG_ZMS=y

# The s25hs512t external flash has write-block-size=256, which exceeds ZMS's
# default 32-byte internal buffer (ZMS_BLOCK_SIZE). ZMS rejects flash with
# write_block_size > ZMS_BLOCK_SIZE with "Unsupported write block size" (-EINVAL).
# Set the ZMS buffer to match the flash write-block-size.
CONFIG_ZMS_CUSTOMIZE_BLOCK_SIZE=y
CONFIG_ZMS_CUSTOM_BLOCK_SIZE=256
```

## drivers/audio/Kconfig.dmic_cat1a
```kconfig
# SPDX-FileCopyrightText: Copyright The Zephyr Project Contributors
# SPDX-License-Identifier: Apache-2.0

# Infineon CAT1A AUDIOSS PDM/PCM DMIC driver (V1, CY_IP_MXAUDIOSS)

config AUDIO_DMIC_CAT1A
	bool "Infineon CAT1A AUDIOSS PDM DMIC driver"
	default y
	depends on DT_HAS_INFINEON_AUDIOSS_PDM_ENABLED
	select USE_INFINEON_PDM_PCM_V1
	select PINCTRL
	select DMA
	help
	  Enable the Infineon CAT1A AUDIOSS PDM/PCM DMIC driver.
	  This driver supports the CY_IP_MXAUDIOSS V1 PDM peripheral
	  present on PSoC6-02 (CAT1A) devices.
```

## drivers/sensor/infineon/bgt60tr13c/Kconfig
```kconfig
# SPDX-FileCopyrightText: Copyright The Zephyr Project Contributors
# SPDX-License-Identifier: Apache-2.0

menuconfig BGT60TR13C
	bool "Infineon XENSIV BGT60TR13C 60 GHz radar sensor"
	default y
	depends on DT_HAS_INFINEON_BGT60TR13C_ENABLED
	select SPI
	select GPIO
	help
	  Enable driver for the Infineon XENSIV BGT60TR13C 60 GHz FMCW
	  radar sensor with integrated antennas.

if BGT60TR13C

choice BGT60TR13C_TRIGGER_MODE
	prompt "Trigger mode"
	default BGT60TR13C_TRIGGER_GLOBAL_THREAD
	help
	  Specify the type of triggering to be used by the driver.

config BGT60TR13C_TRIGGER_NONE
	bool "No trigger"

config BGT60TR13C_TRIGGER_GLOBAL_THREAD
	bool "Use global thread"
	depends on GPIO
	select BGT60TR13C_TRIGGER

config BGT60TR13C_TRIGGER_OWN_THREAD
	bool "Use own thread"
	depends on GPIO
	select BGT60TR13C_TRIGGER

endchoice

config BGT60TR13C_TRIGGER
	bool

config BGT60TR13C_THREAD_PRIORITY
	int "Thread priority"
	depends on BGT60TR13C_TRIGGER_OWN_THREAD
	default 10
	help
	  Priority of thread used by the driver to handle interrupts.

config BGT60TR13C_THREAD_STACK_SIZE
	int "Thread stack size"
	depends on BGT60TR13C_TRIGGER_OWN_THREAD
	default 1024
	help
	  Stack size of thread used by the driver to handle interrupts.

endif # BGT60TR13C
```

## dts/bindings/audio/infineon,audioss-pdm.yaml
```yaml
# SPDX-FileCopyrightText: Copyright The Zephyr Project Contributors
# SPDX-License-Identifier: Apache-2.0

description: |
  Infineon AUDIOSS PDM/PCM controller (V1, CY_IP_MXAUDIOSS) for CAT1A PSoC6
  devices. Supports stereo PDM-to-PCM conversion with one shared PDM bus clock
  and data line.  Left-channel data is clocked on the falling edge; right-channel
  data is clocked on the rising edge, matching the IM72D128 SELECT pin wiring
  (GND = left, VCC = right).

compatible: "infineon,audioss-pdm"

include: ["base.yaml", "pinctrl-device.yaml"]

properties:
  reg:
    required: true

  interrupts:
    required: true

  hf-clock-idx:
    type: int
    required: true
    description: |
      Index of the HF clock that feeds the AUDIOSS PDM block (0-based).
      On PSoC6-02 this is 1 (clk_hf1).

      Example:
        hf-clock-idx = <1>;

  clocks:
    required: false
    description: |
      Optional phandle to the HF clock node.  This is used only to enable
      the clock via the clock-control driver.  The actual clock rate is
      queried at runtime via Cy_SysClk_ClkHfGetFrequency(hf-clock-idx).

  pinctrl-0:
    required: true

  pinctrl-names:
    required: true

  dmas:
    required: true
    description: |
      DMA specifier: phandle of the DW controller and the fixed channel
      connected to the PDM RX 1-to-1 trigger.  On PSoC6-02 this must be
      <&dma1 26> (TRIG_OUT_1TO1_4_PDM0_RX_TO_PDMA1_TR_IN26).

      Example:
        dmas = <&dma1 26>;

  dma-names:
    required: true
    description: |
      Must be "rx".

      Example:
        dma-names = "rx";
```

## dts/bindings/sensor/infineon,bgt60tr13c.yaml
```yaml
# SPDX-FileCopyrightText: Copyright The Zephyr Project Contributors
# SPDX-License-Identifier: Apache-2.0

description: |
  Infineon XENSIV BGT60TR13C 60 GHz radar sensor.

  The BGT60TR13C is a 60 GHz FMCW radar MMIC with one transmitting and three
  receiving antennas. It communicates over SPI and provides an interrupt signal
  for data-ready notification and a reset signal for hardware reset.

compatible: "infineon,bgt60tr13c"

include: ["spi-device.yaml", "sensor-device.yaml"]

properties:
  irq-gpios:
    type: phandle-array
    required: true
    description: |
      GPIO connected to the sensor interrupt (data-ready) output pin.

  reset-gpios:
    type: phandle-array
    required: true
    description: |
      GPIO connected to the sensor active-low hardware reset input pin.
```

## samples/bluetooth/broadcaster/boards/cy8ckit_062s2_ai_cy8c624abzi_s2d44.conf
```kconfig
# CY8CKIT-062S2-AI board overlay for BT broadcaster sample
# Enables logging to trace BT controller initialization

CONFIG_LOG=y
CONFIG_BT_HCI_DRIVER_LOG_LEVEL_INF=y
CONFIG_BT_LOG_LEVEL_INF=y
```
